## firmware/usb-speaker/sdkconfig.defaults
```kconfig
CONFIG_IDF_TARGET="esp32s3"
CONFIG_ESPTOOLPY_FLASHSIZE_16MB=y
CONFIG_ESP_CONSOLE_UART_DEFAULT=y
CONFIG_ESP_CONSOLE_SECONDARY_NONE=y
CONFIG_FREERTOS_HZ=1000
CONFIG_UAC_SPEAKER_CHANNEL_NUM=2
CONFIG_UAC_MIC_CHANNEL_NUM=0
CONFIG_UAC_SAMPLE_RATE=48000
CONFIG_UAC_BIT_RESOLUTION_16=y
CONFIG_UAC_SUPPORT_MACOS=n
CONFIG_UAC_TUSB_MANUFACTURER="StudyPet"
CONFIG_UAC_TUSB_PRODUCT="StudyPet USB Speaker"
CONFIG_UAC_TUSB_SERIAL_NUM="StudyPet-RLCD42-Prototype"
CONFIG_CODEC_ES8311_SUPPORT=y
CONFIG_USB_DEVICE_UAC_AS_PART=y
```
